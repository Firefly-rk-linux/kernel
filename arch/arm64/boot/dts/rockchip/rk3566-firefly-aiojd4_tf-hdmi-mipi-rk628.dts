// SPDX-License-Identifier: (GPL-2.0+ OR MIT)
/*
 * Copyright (c) 2020 Rockchip Electronics Co., Ltd.
 *
 */

 /dts-v1/;

#include "rk3566-firefly-aiojd4.dtsi"

/*
*
* using single camera xc7160        --->  rk3566-firefly-aiojd4-cam-8ms1m.dtsi
* using single camera imx415        --->  rk3566-firefly-aiojd4-cam-imx415.dtsi
* using dual camera gc2053/gc2093   --->  rk3566-firefly-aiojd4-cam-2ms2m.dtsi
* using rk628d                      --->  rk3566-firefly-aiojd4-tf-hdmi-mipi-rk628.dtsi
*
*/
#include "rk3566-firefly-aiojd4-tf-hdmi-mipi-rk628.dtsi"

/ {
    model = "Firefly AIO-3566JD4 HDMI(Linux)";
    compatible = "rockchip,rk3566-firefly-aiojd4", "rockchip,rk3566";
};
